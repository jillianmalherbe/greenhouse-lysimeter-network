## CMakeLists.txt
```
#
# Copyright (c) 2016 Intel Corporation
#
# SPDX-License-Identifier: Apache-2.0
#

cmake_minimum_required(VERSION 3.20.0)
find_package(Zephyr REQUIRED HINTS $ENV{ZEPHYR_BASE})
project(nrf_connect_sdk_fundamentals)

target_sources(app PRIVATE 
    src/main.c
    src/lps28.c)
```

## prj.conf
```kconfig
#
# Copyright (c) 2016 Intel Corporation
#
# SPDX-License-Identifier: Apache-2.0
#

# STEP 2 - Enable the I2C driver
CONFIG_I2C=y
# STEP 4.2 - Enable floating point format specifiers
CONFIG_CBPRINTF_FP_SUPPORT=y

CONFIG_SERIAL=y
#CONFIG_NEWLIB_LIBC=y
#CONFIG_NEWLIB_LIBC_FLOAT_PRINTF=y
```

## src/main.c
```c
#include <zephyr/kernel.h>
#include <zephyr/sys/printk.h>
#include "lps28.h"

#define SLEEP_TIME_MS 1000

int main(void)
{
    int err;
    struct lps28_data lps28_readings = { 0 };

    /* 1) Initialize the sensor */
    err = lps28_init();
    if (err) {
        printk("Failed to initialize LPS28 Sensor (err=%d)\n", err);
        return 0;
    }
    printk("LPS28 Sensor Successfully Initialized\n");

    /* 2) Loop: fetch + print every SLEEP_TIME_MS */
    while (1) {
        err = lps28_fetch(&lps28_readings);
        if (err) {
            printk("Unable to fetch LPS28 data (err=%d)\n", err);
        } else {
            /* Print the floats: note printk with '%.2f' expects doubles, so cast */
            printk("Temp: %.2f °C, Pressure: %.2f hPa\n",
                   (double)lps28_readings.temp_c,
                   (double)lps28_readings.press_hpa);
        }
        k_msleep(SLEEP_TIME_MS);
    }

    return 0;
}
```
